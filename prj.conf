## CMakeLists.txt
```
cmake_minimum_required(VERSION 3.20.0)
find_package(Zephyr REQUIRED HINTS $ENV{ZEPHYR_BASE})
project(blackpill_f103c8_zyphyr)

# QPC framework directory
set(QPC_DIR ${CMAKE_CURRENT_SOURCE_DIR}/third_party/qpc)

# option to turn QSPY software tracing ON or OFF
option(QSPY "QSPY software tracing" OFF)

# QPC framework includes...
zephyr_include_directories(
 ${QPC_DIR}/include
 ${QPC_DIR}/zephyr
)

# QPC framework sources...
target_sources(app PRIVATE
 ${QPC_DIR}/src/qf/qep_hsm.c
 ${QPC_DIR}/src/qf/qep_msm.c
 ${QPC_DIR}/src/qf/qf_act.c
 ${QPC_DIR}/src/qf/qf_qact.c
 ${QPC_DIR}/src/qf/qf_defer.c
 ${QPC_DIR}/src/qf/qf_dyn.c
 ${QPC_DIR}/src/qf/qf_mem.c
 ${QPC_DIR}/src/qf/qf_ps.c
 ${QPC_DIR}/src/qf/qf_qeq.c
 ${QPC_DIR}/src/qf/qf_qmact.c
 ${QPC_DIR}/src/qf/qf_time.c
 ${QPC_DIR}/zephyr/qf_port.c
)

# QPC configuration with QSPY...
if(QSPY)

add_compile_definitions(Q_SPY)

target_sources(app PRIVATE
 ${QPC_DIR}/src/qs/qs.c
 ${QPC_DIR}/src/qs/qs_rx.c
 ${QPC_DIR}/src/qs/qs_fp.c
 ${QPC_DIR}/src/qs/qs_64bit.c
 ${QPC_DIR}/src/qs/qstamp.c
)

endif()

# 添加头文件包含目录
target_include_directories(app PRIVATE ${CMAKE_CURRENT_SOURCE_DIR}/include)

# 添加源文件
FILE(GLOB app_sources src/*.c)
target_sources(app PRIVATE ${app_sources})
target_sources(app PRIVATE src/temperature_control.c)
```

## prj.conf
```kconfig
# QPC Zephyr application
# SPDX-License-Identifier: GPL-3.0-or-later OR LicenseRef-QL-commercial

# System clock tick for QPC (100 ticks per second = 10ms)
CONFIG_SYS_CLOCK_TICKS_PER_SEC=100

# Enable USART1
CONFIG_SERIAL=y

# Enable GPIO
CONFIG_GPIO=y

# Enable printk for debugging
CONFIG_PRINTK=y
CONFIG_LOG=y

# Enable necessary drivers
CONFIG_GPIO_STM32=y
CONFIG_UART_STM32=y

# Enable floating point support for printf
CONFIG_CBPRINTF_FP_SUPPORT=y

# Enable GPIO interrupt support
CONFIG_GPIO=y

# Enable SEGGER RTT
CONFIG_USE_SEGGER_RTT=y

# RTT Configuration
CONFIG_SEGGER_RTT_BUFFER_SIZE_UP=512
CONFIG_SEGGER_RTT_BUFFER_SIZE_DOWN=16
CONFIG_SEGGER_RTT_PRINTF_BUFFER_SIZE=64
CONFIG_SEGGER_RTT_MAX_NUM_UP_BUFFERS=3
CONFIG_SEGGER_RTT_MAX_NUM_DOWN_BUFFERS=3

# Use blocking mode for terminal output
CONFIG_SEGGER_RTT_MODE_BLOCK_IF_FIFO_FULL=y

# Place RTT data in custom section
CONFIG_SEGGER_RTT_SECTION_CUSTOM=y
CONFIG_SEGGER_RTT_CB_ALIGNMENT=16

# UART Configuration
CONFIG_SERIAL=y
CONFIG_UART_INTERRUPT_DRIVEN=y

CONFIG_LOG_BACKEND_RTT=y
CONFIG_UART_CONSOLE=n
```

## src/main.c
```c
/**
 * @file main.c
 * @brief Main application file for the Temperature Control System
 * 
 * This file contains the main entry point for the temperature control system.
 * It initializes all hardware peripherals, QPC framework, and starts the
 * Active Objects for temperature sampling and control.
 */

#include <zephyr/kernel.h>
#include <zephyr/device.h>
#include <zephyr/drivers/gpio.h>
#include <zephyr/drivers/uart.h>
#include <zephyr/logging/log.h>
#include <zephyr/sys/util.h>
#include <zephyr/sys/__assert.h>

#include <zephyr/arch/cpu.h>
#include "ds18b20.h"
#include "led.h"
#include "switch.h"
#include "display.h"

#include "qp.h"

//!< Temperature Control Active Object
#include "temperature_control.h"

//!< Temperature Sampling Active Object
#include "temperature_sampling.h"

LOG_MODULE_REGISTER(main, LOG_LEVEL_INF);

//!< GPIO 设备节点 - 加热器
#define HEATER_NODE DT_ALIAS(heater)
static const struct gpio_dt_spec heater = GPIO_DT_SPEC_GET(HEATER_NODE, gpios);

/**
 * @brief Main application entry point
 * 
 * This function initializes all system components including QPC framework,
 * hardware peripherals, and Active Objects. It then starts the QPC event loop.
 * 
 * @return int Application exit code (typically never returns in embedded systems)
 */
int main(void)
{
    int ret;

    /* 初始化 QPC 框架 */
    QF_init();
    LOG_INF("QPC framework initialized");

    /* 初始化事件池 */
    static QF_MPOOL_EL(QEvt) eventPoolSto[32];  /* 增加事件池大小以避免内存不足 */
    QF_poolInit(eventPoolSto, sizeof(eventPoolSto), sizeof(TemperatureUpdateEvt));
    LOG_INF("QPC event pool initialized (32 events)");

    /* 初始化发布订阅 */
    static QSubscrList subscrSto[16];
    QActive_psInit(subscrSto, Q_DIM(subscrSto));
    LOG_INF("QPC publish-subscribe initialized");

    LOG_INF("Temperature Control System Starting...");

    // 初始化 LED
    ret = led_init();
    if (ret != 0)
    {
        LOG_ERR("Failed to initialize LEDs");
        return ret;
    }

    // 初始化按键中断
    ret = button_init();
    if (ret != 0)
    {
        LOG_ERR("Failed to initialize button interrupt");
        return ret;
    }

    // 初始化开关
    ret = switch_init();
    if (ret != 0)
    {
        LOG_ERR("Failed to initialize switches");
        return ret;
    }

    // 初始化 DS18B20
    if (ds18b20_init() != 0)
    {
        LOG_ERR("Failed to initialize DS18B20");
        // return -1;
    }

    // 初始化加热器 GPIO
    if (!device_is_ready(heater.port))
    {
        LOG_ERR("Heater device not ready");
        return -1;
    }

    // 配置加热器 GPIO
    ret = gpio_pin_configure_dt(&heater, GPIO_OUTPUT | GPIO_OPEN_DRAIN);
    if (ret != 0)
    {
        LOG_ERR("Failed to configure heater");
        return ret;
    }

    // 初始化 LED 状态
    led_set_single(2);  // 默认点亮第 3 个 LED（索引 2）
    gpio_pin_set_dt(&heater, 0);

    // 初始化数码管
    LOG_INF("Initializing display...");
    ret = display_init();
    if (ret != 0)
    {
        LOG_ERR("Failed to initialize display");
        return ret;
    }
    LOG_INF("Display initialized successfully");

    /* 初始化温度采样 Active Object */
    LOG_INF("Initializing Temperature Sampling AO...");
    TempSampler_ctor();

    /* 初始化温度控制 Active Object */
    LOG_INF("Initializing Temperature Control AO...");
    TempCtrl_ctor();

    /* 启动 QPC 事件循环 */
    LOG_INF("Starting QPC event loop");
    return QF_run();
}
```

## include/bsp.h
```c
/**
 * @file bsp.h
 * @brief Board Support Package for rt-a19_V2.0 project
 * 
 * This file provides board support package definitions for the rt-a19_V2.0
 * project, including QPC tick configuration, signal definitions, and
 * error handling interfaces.
 */

#ifndef BSP_H
#define BSP_H

#include <zephyr/kernel.h>
#include "qpc.h"

#ifdef __cplusplus
extern "C"
{
#endif

//!< QPC tick 配置 - QPC tick 间隔（毫秒）
#define QPC_TICK_MS 10 

/**
 * @brief 将毫秒转换为 QPC tick 数
 * @note 公式：ms / QPC_TICK_MS
 * @example MS2QPC(500) = 500 / 10 = 50 tick
 * @param ms 毫秒数
 * @return 对应的 QPC tick 数
 */
#define MS2QPC(ms) ((ms) / QPC_TICK_MS)

/**
 * @brief 应用程序信号枚举
 * 
 * 定义应用程序中使用的所有 QPC 信号，包括发布信号和投递信号。
 */
enum AppSignals {
    /* Published Signals - 用于发布订阅模式 */
    TEMP_UPDATE_SIG = Q_USER_SIG,    //!< 温度更新通知
    DISPLAY_UPDATE_SIG,              //!< 显示更新通知

    /* Posted Signals - 用于直接投递到特定 AO */
    TEMP_TIMEOUT_SIG,                //!< 温度采样定时器超时
    DISPLAY_TIMEOUT_SIG,             //!< 显示刷新定时器超时
    BUTTON_PRESSED_SIG,              //!< 按键按下信号
    HEAT_CONTROL_SIG,                //!< 加热控制信号

    MAX_SIG                          //!< 信号枚举最大值标记
};

/**
 * @brief QPC 错误处理函数
 * 
 * 当 QPC 框架中发生错误时调用此函数，提供错误的模块名和 ID。
 * 
 * @param module 发生错误的模块名称
 * @param id 错误 ID
 */
Q_NORETURN Q_onError(char const *const module, int const id);

/**
 * @brief QPC 时钟滴答处理函数
 * 
 * 处理 QPC 时钟滴答事件，通常用于驱动定时器和时间事件。
 */
void QF_onClockTick(void);

/**
 * @brief QPC 启动处理函数
 * 
 * QPC 框架启动时调用此函数，用于执行必要的初始化任务。
 */
void QF_onStartup(void);

#ifdef __cplusplus
}
#endif

#endif /* BSP_H */
```

## include/display.h
```c
#ifndef DISPLAY_H
#define DISPLAY_H

/**
 * @brief Initialize 7-segment display GPIO
 * @return 0 on success, -1 on failure
 */
int display_init(void);

/**
 * @brief Display temperature on 7-segment display
 * @param temperature Temperature value to display
 */
void display_temp(float temperature);

#endif /* DISPLAY_H */
```

## include/ds18b20.h
```c
#ifndef DS18B20_H
#define DS18B20_H

/**
 * @brief Initialize DS18B20 sensor
 * @return 0 on success, -1 on failure
 */
int ds18b20_init(void);

/**
 * @brief Read temperature from DS18B20
 * @return Temperature value in Celsius
 */
float ds18b20_read_temperature(void);

/**
 * @brief Run DS18B20 diagnostic test
 */
void ds18b20_diagnostic(void);

#endif /* DS18B20_H */
```

## include/gpio_control.h
```c
#ifndef __GPIO_CONTROL_H
#define __GPIO_CONTROL_H

#ifdef __cplusplus
extern "C" {
#endif

#include <stdint.h>

/* 函数声明 */
void GPIO_Control_Init(void);

// 键盘行控制函数
void GPIO_SetKeyRows(uint8_t row_pattern);
void GPIO_SetKeyRow(uint8_t row, uint8_t state);

// 键盘列读取函数
uint8_t GPIO_ReadKeyCols(void);
uint8_t GPIO_ReadKeyCol(uint8_t col);

// LED 控制函数
void GPIO_SetLED(uint8_t led_num, uint8_t state);
void GPIO_ToggleLED(uint8_t led_num);

// 键盘扫描函数
uint16_t GPIO_ScanKeyboard(void);

// 特殊按键控制函数
void GPIO_SetSpecialKeyOutput(uint8_t key_type, uint8_t state);
uint8_t GPIO_ReadSpecialKeyInput(uint8_t key_type);

#ifdef __cplusplus
}
#endif

#endif /* __GPIO_CONTROL_H */
```

## include/keyboard_logic.h
```c
#ifndef __KEYBOARD_LOGIC_H
#define __KEYBOARD_LOGIC_H

#ifdef __cplusplus
extern "C" {
#endif

#include <stdint.h>



/* 宏定义 */
#define SCANCODESET_1    1
#define SCANCODESET_2    2
#define SCANCODESET_3    3

#define SCANCODESET   SCANCODESET_2

#define MACHINE_1904C   0x10
#define MACHINE_9000    0x13
// HOSTMACHINE 定义已移至 timer.h

#define TRUE      1
#define FALSE     0

#define UINT8     uint8_t
#define UINT16    uint16_t

#define TRANSDELAY  20

#define MAX9000SCAN   3
#define MAX1904SCAN   3

/* 全局变量声明 */
extern volatile unsigned int gKey_Buffer;        //common keycode buffer
extern volatile unsigned int gFunc_Buffer;       //function keycode buffer
extern volatile uint8_t Flag_Updown;             //the flag of function key keeping down or not
extern volatile uint8_t Flag_Key;                //the flag of any key keeping down or not

extern volatile uint8_t Key9000c;

extern volatile char G_uc9000ScanInterval;

UINT8 Key_Scan(void);
unsigned int Key_Decode(unsigned int key);
void Function_Key_Decode(unsigned int Func_Key);
UINT8 ScanSpecialKeys(void);
void Keyboard_Scan_And_Transmit(void);

#ifdef __cplusplus
}
#endif

#endif /* __KEYBOARD_LOGIC_H */
```

## include/led.h
```c
#ifndef LED_H
#define LED_H

#include <stdint.h>

#define LED_COUNT 4

/**
 * @brief Initialize all LEDs
 * @return 0 on success, -1 on failure
 */
int led_init(void);

/**
 * @brief Set state of a single LED
 * @param led_index LED index (0-3)
 * @param state 0 for off, 1 for on
 */
void led_set_state(uint8_t led_index, int state);

/**
 * @brief Set state of all LEDs
 * @param state 0 for off, 1 for on
 */
void led_set_all(int state);

/**
 * @brief Set only one LED on, all others off
 * @param led_index LED index (0-3) to turn on
 */
void led_set_single(uint8_t led_index);

/**
 * @brief Set LED pattern using bit mask
 * @param pattern Bit mask where bit i controls LED i
 */
void led_set_pattern(uint8_t pattern);

#endif /* LED_H */
```

## include/pid.h
```c
#ifndef PID_H
#define PID_H

/**
 * @brief PID 控制器结构体
 */
typedef struct {
    float kp;           // 比例系数
    float ki;           // 积分系数
    float kd;           // 微分系数
    float setpoint;     // 设定值
    float integral;     // 积分项
    float prev_error;   // 上一次误差
    float output_min;   // 输出最小值
    float output_max;   // 输出最大值
} pid_controller_t;

/**
 * @brief 初始化 PID 控制器
 * @param pid PID 控制器指针
 * @param kp 比例系数
 * @param ki 积分系数
 * @param kd 微分系数
 * @param setpoint 设定值
 * @param output_min 输出最小值
 * @param output_max 输出最大值
 */
void pid_init(pid_controller_t *pid, float kp, float ki, float kd, float setpoint, float output_min, float output_max);

/**
 * @brief 计算 PID 输出
 * @param pid PID 控制器指针
 * @param measurement 当前测量值
 * @return PID 输出值
 */
float pid_compute(pid_controller_t *pid, float measurement);

/**
 * @brief 设置 PID 设定值
 * @param pid PID 控制器指针
 * @param setpoint 设定值
 */
void pid_set_setpoint(pid_controller_t *pid, float setpoint);

/**
 * @brief 重置 PID 控制器
 * @param pid PID 控制器指针
 */
void pid_reset(pid_controller_t *pid);

#endif /* PID_H */
```

## include/qp_config.h
```c
/**
 * @file qp_config.h
 * @brief QPC Framework Configuration for rt-a19_V2.0 project
 */

#ifndef QP_CONFIG_H
#define QP_CONFIG_H

#define QF_MAX_EPOOL 3U                                 /* Maximum # Event Pools */
#define QF_MAX_TICK_RATE 1U                             /* Maximum # clock tick rates */
#define QF_EVENT_SIZ_SIZE 2U                            /* Size of dynamic events */
#define QF_TIMEEVT_CTR_SIZE 4U                          /* Size of QTimeEvt counter */
#define QF_EQUEUE_CTR_SIZE 1U                           /* Size of event queue counter */
#define QF_MPOOL_CTR_SIZE 2U                            /* Size of memory pool counter */
#define QF_MPOOL_SIZ_SIZE 2U                            /* Size of memory pool block */

/* Zephyr 特定配置 */
#define QF_ON_CONTEXT_SW 1           /* 启用上下文切换支持 */

/* 禁用 QSPY tracing (开源版本不支持) */
#undef Q_SPY

#endif /* QP_CONFIG_H */
```

## include/switch.h
```c
#ifndef SWITCH_H
#define SWITCH_H

#include <stdbool.h>

#define SWITCH_COUNT 4

/**
 * @brief Initialize all switches
 * @return 0 on success, -1 on failure
 */
int switch_init(void);

/**
 * @brief Read switch settings
 * @return Temperature offset value with sign
 */
float switch_read_settings(void);

/**
 * @brief Initialize button interrupt
 * @return 0 on success, -1 on failure
 */
int button_init(void);

#endif /* SWITCH_H */
```

## include/temperature_control.h
```c
/**
 * @file temperature_control.h
 * @brief Temperature Control Active Object
 * 
 * This file defines the interface for the Temperature Control Active Object,
 * which manages temperature control using PID algorithm, controls heating,
 * and manages display updates.
 */

#ifndef TEMPERATURE_CONTROL_H
#define TEMPERATURE_CONTROL_H

#include "qpc.h"
#include "bsp.h"
#include "pid.h"

#ifdef __cplusplus
extern "C"
{
#endif

//!< 温度设定值档位数量
#define TEMP_SETPOINT_COUNT 4

//!< Active Object 配置 - 栈大小
#define TEMPCTRL_AO_STACK_SIZE 2048
//!< Active Object 配置 - 优先级
#define TEMPCTRL_AO_PRIORITY 8

/**
 * @brief 按键按下事件结构体
 * 
 * 定义了按键按下事件的数据结构
 */
typedef struct {
    QEvt super;  //!< QPC 事件基类
} ButtonPressEvent;

/**
 * @brief PID 控制参数结构体
 * 
 * 包含 PID 控制器的所有参数配置
 */
typedef struct {
    float kp;          //!< 比例系数
    float ki;          //!< 积分系数
    float kd;          //!< 微分系数
    float setpoint;    //!< 设定点值
    float output_min;  //!< 输出最小值
    float output_max;  //!< 输出最大值
} PidParams;

/**
 * @brief 温度控制 Active Object 结构体
 * 
 * 定义了温度控制 Active Object 的数据结构，包括 PID 控制器、
 * 温度数据、定时器和其他控制参数。
 */
typedef struct {
    QActive super;     //!< QPC Active Object 基类

    /* 定时器 */
    QTimeEvt timeEvtDisp;   //!< 显示刷新定时器
    QTimeEvt timeEvtHeat;   //!< 加热控制定时器 (100ms周期)

    /* 温度数据 */
    float current_temp;        //!< 当前温度值
    float display_temp;        //!< 显示温度值
    float last_display_temp;   //!< 上一次显示温度值
    float temp_offset;         //!< 温度偏移值

    /* PID 控制器 */
    pid_controller_t pid;      //!< PID 控制器实例
    PidParams pid_params;      //!< PID 控制参数

    /* 温度设定值 */
    float setpoints[TEMP_SETPOINT_COUNT];  //!< 温度设定值数组
    uint8_t current_setpoint_idx;          //!< 当前设定值索引

    /* 统计数据 */
    uint32_t sample_count;     //!< 采样计数

    /* 加热控制相关变量 */
    float pid_output;          //!< 最新的PID输出值
    uint8_t heat_cycle_pos;    //!< 当前加热周期位置 (0-9)
    uint8_t heat_on_count;     //!< 当前周期内加热的次数

} TempCtrl;

/**
 * @brief 构造温度控制 Active Object
 * 
 * 初始化温度控制 Active Object，设置初始参数和启动 AO。
 */
void TempCtrl_ctor(void);

#ifdef __cplusplus
}
#endif

#endif /* TEMPERATURE_CONTROL_H */
```

## include/temperature_sampling.h
```c
/**
 * @file temperature_sampling.h
 * @brief Temperature Sampling Active Object
 * 
 * This file defines the interface for the Temperature Sampling Active Object,
 * which handles temperature reading from DS18B20 sensors and publishes
 * temperature updates to other Active Objects.
 */

#ifndef TEMPERATURE_SAMPLING_H
#define TEMPERATURE_SAMPLING_H

#include "qpc.h"
#include "bsp.h"

#ifdef __cplusplus
extern "C"
{
#endif

//!< 温度采样工作队列栈大小
#define TEMP_SAMPLING_WORK_STACK_SIZE 1024
//!< 温度采样工作队列优先级
#define TEMP_SAMPLING_WORK_PRIORITY K_LOWEST_APPLICATION_THREAD_PRIO

//!< Active Object 栈大小
#define TEMP_SAMPLING_AO_STACK_SIZE 2048
//!< Active Object 优先级
#define TEMP_SAMPLING_AO_PRIORITY 7

/**
 * @brief 温度更新事件结构体
 * 
 * 定义了温度更新事件的数据结构，包含温度值和采样计数。
 */
typedef struct {
    QEvt super;          //!< QPC 事件基类
    float temperature;   //!< 温度值
    uint32_t sample_count;  //!< 采样计数
} TemperatureUpdateEvt;

/**
 * @brief 温度采样 Active Object 结构体
 * 
 * 定义了温度采样 Active Object 的数据结构，包含定时器、
 * 工作队列和温度数据等。
 */
typedef struct {
    QActive super;         //!< QPC Active Object 基类

    /* 定时器 */
    QTimeEvt timeEvtTemp;  //!< 温度采样定时器

    /* 温度采样工作队列（用于异步执行 DS18B20 读取） */
    struct k_work temp_work;    //!< 工作项
    struct k_work_q temp_work_q; //!< 工作队列

    /* 温度数据 */
    float current_temp;     //!< 当前温度值
    uint32_t sample_count;  //!< 采样计数

} TempSampler;

/**
 * @brief 构造温度采样 Active Object
 * 
 * 初始化温度采样 Active Object，设置初始参数和启动 AO。
 */
void TempSampler_ctor(void);

#ifdef __cplusplus
}
#endif

#endif /* TEMPERATURE_SAMPLING_H */
```

## include/uart_wrapper.h
```c
#ifndef UART_WRAPPER_H
#define UART_WRAPPER_H

#include <stdint.h>
#include <stdbool.h>

/**
 * @brief 发送字符串到 UART
 * @param buf 要发送的字符串
 */
void print_uart(const char *buf);

/**
 * @brief 检查 UART 设备是否就绪
 * @return true 如果设备就绪, false 否则
 */
bool uart_is_ready(void);

/**
 * @brief 发送单个字符到 UART
 * @param c 要发送的字符
 */
void uart_send_char(char c);

void uart_send_hex(const char *buf, int len);

/**
 * @brief 发送字符串到 UART
 * @param str 要发送的字符串
 */
void uart_send_string(const char* str);

/**
 * @brief 兼容旧程序的串口初始化函数
 */
void Serial_Init(void);

/**
 * @brief 兼容旧程序的发送单个字符函数
 * @param ch 要发送的字符 (uint8_t)
 */
void SendChar(uint8_t ch);

#endif /* UART_WRAPPER_H */
```
